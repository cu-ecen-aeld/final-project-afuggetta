## base_external/Config.in
```kconfig
menu "Base external customizations"

source "$BR2_EXTERNAL_project_base_PATH/package/envchar/Config.in"
source "$BR2_EXTERNAL_project_base_PATH/package/sensor_daemon/Config.in"
source "$BR2_EXTERNAL_project_base_PATH/package/aesdsocket/Config.in"

endmenu
```

## base_external/package/aesdserver/Config.in
```kconfig
config BR2_PACKAGE_AESDSERVER
    bool "extended aesdserver (placeholder)"
    help
      Placeholder for extended aesdsocket-based TCP server.
      Implementation in Sprint 2.
```

## base_external/package/aesdsocket/Config.in
```kconfig
config BR2_PACKAGE_AESDSOCKET
	bool "aesdsocket"
	help
	  TCP server implementing the final project protocol.
	  Listens on port 9000 and serves data from /dev/envchar.
```

## base_external/package/envchar/Config.in
```kconfig
config BR2_PACKAGE_ENVCHAR
    bool "envchar kernel module"
    help
      Kernel module providing /dev/envchar character device.
      Used to store timestamped environment/presence records.
```

## base_external/package/sensor_daemon/Config.in
```kconfig
config BR2_PACKAGE_SENSOR_DAEMON
	bool "sensor_daemon"
	help
	  Daemon that periodically logs presence records
	  to /dev/envchar in text format.
```
